## conf/distro/include/partitions.inc
```bitbake
# Partition scheme versioning.
#
# 1. Major version is increased whenever the size, location, and/or numbering
#    of partitions are/is changed.
# 2. Increasing the major version implies changing the minor version to 0.
# 3. Minor version is increased whenever any partition properties, such as file
#    system type, file system options, or volume label, have changed.
#
# Equal major version implies that partition tables are compatible and
# partitions with different minor versions can be mixed.
# Different major version implies need for repartitioning and may involve a
# risky update procedure.
PARTITION_LAYOUT_MAJOR_VERSION = "2"
PARTITION_LAYOUT_MINOR_VERSION = "0"


#
# Main system partitions
#

# 16 MiB for main boot partition
MAINBOOT_PARTITION_NUMBER          ?= "1"
MAINBOOT_PARTITION_SIZE            ?= "16384"
MAINBOOT_PARTITION_MOUNTPOINT      ?= "/bootpartm"
MAINBOOT_TYPE                      ?= "fat32"
MAINBOOT_MKFS_EXTRA                ?= "-n Boot"

# How U-Boot should load the main system's kernel
MAIN_KERNEL_LOADCMD_UBOOT          ?= "ext4load"
MAIN_KERNEL_DEVICE_UBOOT           ?= "7"
MAIN_KERNEL_PATH_UBOOT             ?= "boot"

# Linux root filesystem device name passed as kernel parameter
MAIN_KERNEL_ROOTFS_DEVICE          ?= "/dev/mmcblk0p7"

# 1024 MiB for main rootfs
MAINROOTFS_PARTITION_NUMBER        ?= "7"
MAINROOTFS_PARTITION_SIZE          ?= "1048576"
MAINROOTFS_TYPE                    ?= "ext4"
MAINROOTFS_MKFS_EXTRA              ?= "-i 4096 -m 0 -L Rootfs"

# 128 MiB for user settings
MAINCONFIGFS_PARTITION_NUMBER      ?= "5"
MAINCONFIGFS_PARTITION_SIZE        ?= "131072"
MAINCONFIGFS_TYPE                  ?= "ext4"
MAINCONFIGFS_MKFS_EXTRA            ?= "-i 4096 -m 0 -O quota -L Settings"
MAINCONFIGFS_MOUNTPOINT            ?= "${localstatedir}/local/etc"


#
# Recovery system partitions
#

# 128 MiB for recovery boot partition
# this one needs to be large enough to hold the kernel, the initramfs rootfs
# image, and Broadcom BLOBs (see also RECOVERYROOTFS_PARTITION_SIZE below)
RECOVERYBOOT_PARTITION_NUMBER      ?= "2"
RECOVERYBOOT_PARTITION_SIZE        ?= "131072"
RECOVERYBOOT_PARTITION_MOUNTPOINT  ?= "/bootpartr"
RECOVERYBOOT_TYPE                  ?= "fat32"
RECOVERYBOOT_MKFS_EXTRA            ?= "-n BootR"

# 64 MiB for recovery rootfs
RECOVERYROOTFS_PARTITION_SIZE      ?= "65536"
RECOVERYROOTFS_TYPE                ?= "cpio.xz"
RECOVERYROOTFS_MKFS_EXTRA          ?= "-i 4096 -m 0 -L RootfsR"
RECOVERYROOTFS_INITRAMFS_IMAGE     ?= "strbo-recovery-image"

# How U-Boot should load the recovery system's kernel
RECOVERY_KERNEL_LOADCMD_UBOOT      ?= "fatload"
RECOVERY_KERNEL_DEVICE_UBOOT       ?= "2"
RECOVERY_KERNEL_PATH_UBOOT         ?= ""

# Data for full recovery of a broken system to known state.
RECOVERYDATAFS_PARTITION_NUMBER    ?= "6"
RECOVERYDATAFS_PARTITION_SIZE      ?= "1048576"
RECOVERYDATAFS_TYPE                ?= "ext4"
RECOVERYDATAFS_MKFS_EXTRA          ?= "-i 4096 -m 0 -T largefile -L DataR"
RECOVERYDATAFS_MOUNTPOINT          ?= "/src"


#
# Shared partitions
#

# Spare partition
SPAREFS_PARTITION_NUMBER           ?= "8"
SPAREFS_TYPE                       ?= "ext4"
SPAREFS_MKFS_EXTRA                 ?= "-i 4096 -m 0 -O quota -L Data"
SPAREFS_MOUNTPOINT                 ?= "${localstatedir}/local/data"
```

## conf/distro/strbo-main.conf
```bitbake
DISTRO = "strbo-main"
DISTRO_NAME = "StrBo (T+A Streaming Board)"
DISTRO_CODENAME ?= "${DISTRO_LINE}"
DISTRO_VERSION ?= "0.0.0"
DISTRO_FEATURES = "alsa argp ext2 largefile polkit systemd usbhost wifi xattr"
VIRTUAL-RUNTIME_login_manager = "shadow"
VIRTUAL-RUNTIME_init_manager = "systemd"
VIRTUAL-RUNTIME_initscripts = "systemd-compat-units"
VIRTUAL-RUNTIME_base-utils = ""
DISTRO_FEATURES_BACKFILL_CONSIDERED = "sysvinit"
DISTRO_FEATURES:remove = " opengl pulseaudio bluez5"

MAINTAINER = "T+A elektroakustik GmbH & Co. KG <e-service@ta-hifi.com>"

hostname:pn-base-files := "ta-streaming-board"

LOCALCONF_VERSION = "2"
LAYER_CONF_VERSION ?= "8"

SANITY_TESTED_DISTROS ?= " \
            ubuntu-14.04 \n \
            ubuntu-16.04 \n \
            ubuntu-18.04 \n \
            ubuntu-20.04 \n \
            "

HAVE_DEVELOPER_ACCOUNT = "yes"

KERNEL_IMAGETYPE = "uImage"
MACHINE_EXTRA_RRECOMMENDS += " kernel-devicetree"
PREFERRED_PROVIDER_virtual/kernel = "linux-strbo-main"

SYSTEMD_DEFAULT_TARGET = "strbo.target"

# use SHA256 checksums instead of MD5 in package files, and use GPG for
# signature verification
PACKAGECONFIG:append:pn-opkg = " sha256 gpg"
PACKAGECONFIG:append:pn-opkg-native = " sha256"

# read out systemd journal via HTTP (disabled by default)
PACKAGECONFIG:append:pn-systemd = " microhttpd"

# some extra plugins for GStreamer
PACKAGECONFIG:remove:pn-gstreamer1.0-plugins-base = "opengl egl gles2"
PACKAGECONFIG:append:pn-gstreamer1.0-plugins-bad = "hls libmms rtmp faad opus modplug"
PACKAGECONFIG:append:pn-gstreamer1.0-plugins-good = "wavpack"

# pimp up gdb
EXTRA_OECONF:append:pn-gdb-cross-canadian-arm = "--enable-tui --enable-x"
EXTRA_OECONF:append:pn-gdb-cross-arm = "--enable-tui --enable-x"

IMAGE_FSTYPES = "tar.xz"

OELAYOUT_ABI = "8"
INHERIT += "poky-sanity"
WARN_TO_ERROR_QA = "already-stripped compile-host-path install-host-path \
                    installed-vs-shipped ldflags pn-overrides rpaths staticdev \
                    unknown-configure-option useless-rpaths"
WARN_QA:remove = "${WARN_TO_ERROR_QA}"
ERROR_QA:append = " ${WARN_TO_ERROR_QA}"

# Optionally override variables locally
include strbo-main-override.conf
```

## conf/distro/strbo-recovery.conf
```bitbake
DISTRO = "strbo-recovery"
DISTRO_NAME = "StrBo (T+A Streaming Board) Recovery"
DISTRO_CODENAME ?= "${DISTRO_LINE}"
DISTRO_VERSION ?= "0.0.0"
DISTRO_FEATURES = "argp ext2 largefile polkit systemd usbhost wifi xattr"
VIRTUAL-RUNTIME_login_manager = "shadow"
VIRTUAL-RUNTIME_init_manager = "systemd"
VIRTUAL-RUNTIME_initscripts = "systemd-compat-units"
VIRTUAL-RUNTIME_base-utils = ""
DISTRO_FEATURES_BACKFILL_CONSIDERED = "sysvinit"

MAINTAINER = "T+A elektroakustik GmbH & Co. KG <e-service@ta-hifi.com>"

hostname_pn-base-files := "ta-streaming-board-recovery"

LOCALCONF_VERSION = "2"
LAYER_CONF_VERSION ?= "8"

SANITY_TESTED_DISTROS ?= " \
            ubuntu-14.04 \n \
            ubuntu-16.04 \n \
            ubuntu-18.04 \n \
            ubuntu-20.04 \n \
            "

KERNEL_IMAGETYPE = "uImage"
MACHINE_EXTRA_RRECOMMENDS += " kernel-devicetree"
PREFERRED_PROVIDER_virtual/kernel = "linux-strbo-recovery"

PREFERRED_VERSION_gnutls-native = "3.6.12"
PREFERRED_VERSION_nettle-native = "3.5.1"

# read out systemd journal via HTTP (disabled by default)
PACKAGECONFIG_append_pn-systemd = " microhttpd"

# pimp up gdb
EXTRA_OECONF_append_pn-gdb-cross-canadian-arm = "--enable-tui --enable-x"
EXTRA_OECONF_append_pn-gdb-cross-arm = "--enable-tui --enable-x"

IMAGE_FSTYPES = "tar.xz"

OELAYOUT_ABI = "8"
INHERIT += "poky-sanity"
WARN_TO_ERROR_QA = "already-stripped compile-host-path install-host-path \
                    installed-vs-shipped ldflags pn-overrides rpaths staticdev \
                    unknown-configure-option useless-rpaths"
WARN_QA_remove = "${WARN_TO_ERROR_QA}"
ERROR_QA_append = " ${WARN_TO_ERROR_QA}"

# Optionally override variables locally
include strbo-recovery-override.conf
```

## conf/layer.conf
```bitbake
BBPATH .= ":${LAYERDIR}"

BBFILES += "${LAYERDIR}/recipes-*/*/*.bb \
            ${LAYERDIR}/recipes-*/*/*.bbappend"

BBFILE_COLLECTIONS += "strbo-free"
BBFILE_PATTERN_strbo-free := "^${LAYERDIR}/"
BBFILE_PRIORITY_strbo-free = "5"
LAYERVERSION_strbo-free = "1"
LAYERDEPENDS_strbo-free = "core"
LAYERSERIES_COMPAT_strbo-free = "honister"
```

## recipes-bsp/u-boot/files/strbo_main_defconfig
```kconfig
CONFIG_ARM=y
CONFIG_ARCH_BCM283X=y
CONFIG_ARCH_EARLY_INIT_R=y
CONFIG_SYS_TEXT_BASE=0x00008000
CONFIG_TARGET_RPI=y
CONFIG_DEFAULT_DEVICE_TREE="bcm2835-rpi-cm1-io1"
CONFIG_DISTRO_DEFAULTS=n
CONFIG_NR_DRAM_BANKS=1
CONFIG_OF_BOARD_SETUP=y
CONFIG_STRBO_RECOVERY_BOOTLOADER=n
CONFIG_MISC_INIT_R=y
CONFIG_BOOTDELAY=0
# CONFIG_DISPLAY_CPUINFO is not set
# CONFIG_DISPLAY_BOARDINFO is not set
CONFIG_SYS_PROMPT="T+A> "
# CONFIG_CMD_FLASH is not set
CONFIG_CMD_GPIO=y
CONFIG_CMD_MMC=y
CONFIG_CMD_USB=y
CONFIG_CMD_FS_UUID=y
CONFIG_OF_EMBED=y
CONFIG_ENV_IS_NOWHERE=y
CONFIG_DM_KEYBOARD=y
CONFIG_DM_MMC=y
CONFIG_MMC_SDHCI=y
CONFIG_MMC_SDHCI_BCM2835=y
CONFIG_CMD_EXT4=y
CONFIG_CMD_FAT=y
CONFIG_CMD_FS_GENERIC=y
CONFIG_CMD_PART=y
CONFIG_CMD_BOOTPART=y
CONFIG_HUSH_PARSER=y
CONFIG_DM_ETH=n
CONFIG_PINCTRL=y
# CONFIG_PINCTRL_GENERIC is not set
# CONFIG_REQUIRE_SERIAL_CONSOLE is not set
CONFIG_USB=y
CONFIG_DM_USB=y
CONFIG_USB_DWC2=n
CONFIG_USB_STORAGE=n
CONFIG_USB_KEYBOARD=n
CONFIG_SYS_USB_EVENT_POLL=n
CONFIG_USB_HOST_ETHER=n
CONFIG_USB_ETHER_SMSC95XX=n
CONFIG_DM_VIDEO=n
CONFIG_LCD_DT_SIMPLEFB=n
CONFIG_VIDEO_SIMPLE=n
CONFIG_VIDEO_DT_SIMPLEFB=n
CONFIG_PHYS_TO_BUS=y
CONFIG_OF_LIBFDT_OVERLAY=y
# CONFIG_LOG=y
# CONFIG_DEBUG_UART=y
# CONFIG_DEBUG_UART_PL011=y
# CONFIG_DEBUG_UART_BASE=0x7e201000
# CONFIG_DEBUG_UART_CLOCK=48000000
# CONFIG_DEBUG_UART_SKIP_INIT=y
```
